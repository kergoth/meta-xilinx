/ {
        amba@0 {
                zynq-rpmsg_driver@0 {
                        compatible = "xlnx,zynq_rpmsg_driver";
                        reg = <0x20000000 0x208000>;
                        dev-feature = <0x1>;
                        gen-feature = <0x0>;
                        num-vrings = <0x2>;
                        num-descs = <0x100>;
                        alignment = <0x1000>;
                        vring0 = <0x6>;
                        vring1 = <0x3>;
                        virtioid = <0x7>;
                        ringtx = <0x20000000>;
                        ringrx = <0x20040000>;
                };
                test: remoteproc-test@0 {
                         compatible = "xlnx,zynq_remoteproc";
                         reg = < 0x0 0x10000000 >;
                         interrupt-parent = <&ps7_scugic_0>;
                         interrupts = < 0x0 0x25 0x4 0x0 0x26 0x4 >;
                         firmware = "firmware";
                         ipino = <0x6>;
                         vring0 = <0x2>;
                         vring1 = <0x3>;
                      } ;
        };
};

