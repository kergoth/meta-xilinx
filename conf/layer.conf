## conf/layer.conf
```bitbake
# We have a conf and classes directory, add to BBPATH
BBPATH .= ":${LAYERDIR}"

BBFILES += "${LAYERDIR}/recipes-*/*/*.bb \
            ${LAYERDIR}/recipes-*/*/*.bbappend \
           "

# Let us add layer-specific bbappends which are only applied when that
# layer is included in our configuration
BBFILES += "${@' '.join('${LAYERDIR}/%s/recipes*/*/*.bbappend' % layer \
               for layer in BBFILE_COLLECTIONS.split())}"

BBFILE_COLLECTIONS += "xilinx-mel"
BBFILE_PATTERN_xilinx-mel := "^${LAYERDIR}/"
BBFILE_PRIORITY_xilinx-mel = "10"
#LAYERDEPENDS_xilinx-mel = "core meta-xilinx"
LAYERDEPENDS_xilinx-mel = "core xilinx"
```

## conf/machine/zc702-zynq7-mel.conf
```bitbake
#@TYPE: Machine
#@NAME: zc702-zynq7-mel
#@DESCRIPTION: Mentor Embedded Linux Machine support for ZC702 Evaluation Board.
#
# For full details on the ZC702EK and associated tools, refer to the meta-xilinx
# layer.

require conf/machine/include/tune-zynq.inc
require conf/machine/include/machine-xilinx-default.inc
require conf/machine/include/machine-xilinx-board.inc

# ZC70x machine definition known by Xilinx UBOOT
UBOOT_MACHINE = "zynq_zc70x_config"

SERIAL_CONSOLE = "115200 ttyPS0"

MACHINE_DEVICETREE := " \
		zc702-mel/zc702-zynq7-mel.dts \
		${@bb.utils.contains("MACHINE_FEATURES", "hdmi", "zc702-mel/zc702-zynq7-base-trd-2015-2.dts", "", d)} \
		"

MACHINE_KCONFIG := "common/linux/rtc.cfg"

MACHINE_FEATURES = "vfat ext2 mel-master"

MACHINE_EXTRA_RRECOMMENDS += "udev-extraconf kernel-modules"

MACHINEOVERRIDES_append = ":zc702"

IMAGE_BOOT_FILES += "boot.bin uEnv.txt ${MACHINE}.dtb ${@bb.utils.contains("MACHINE_FEATURES", "hdmi", "zc702-zynq7-base-trd-2015-2.dtb", "", d)}"

# u-boot is needed for the IMAGE_BOOT_FILES
do_image_wic[depends] += "virtual/bootloader:do_deploy"

# WIC image type support
IMAGE_FSTYPES += "wic"
WKS_FILE ?= "sdimage-bootpart-4g.wks"

# dosfstools is needed to create the boot partition, mtools to copy to it
IMAGE_DEPENDS_wic_append = " dosfstools-native mtools-native parted-native"
```

## conf/machine/zcu102-zynqmp-mel.conf
```bitbake
#@TYPE: Machine
#@NAME: zcu102-zynqmp-mel
#@DESCRIPTION: Mentor Embedded Linux Machine support for zcu102 MPSoc Evaluation Board.
#
# For full details on the ZCU102 and associated tools, refer to the meta-xilinx
# layer.

require conf/machine/zcu102-zynqmp.conf

#mask buggy bbappends
BBMASK += "/recipes-zynqmp/qemu/qemu_2.5%.bbappend"
BBMASK += "/recipes-bsp/u-boot/u-boot-xlnx_2015.04.bbappend"
BBMASK += "/recipes-multimedia/gstreamer/gstreamer1.0_1.6.3.bbappend"

PREFERRED_PROVIDER_virtual/bootloader = "u-boot-xlnx-dev"

PREFERRED_PROVIDER_virtual/libgles1 = "libmali-xlnx"
PREFERRED_PROVIDER_virtual/libgles2 = "libmali-xlnx"
PREFERRED_PROVIDER_virtual/egl = "libmali-xlnx"

XSERVER = " \
           xserver-xorg \
           xf86-input-evdev \
           xf86-input-mouse \
           xf86-input-keyboard \
           ${@bb.utils.contains('DISTRO_FEATURES', 'opengl', 'xserver-xorg-extension-glx', '', d)} \
           "
XSERVER_append = " xf86-video-armsoc"

# WIC image type support
IMAGE_FSTYPES += "wic.bz2"
WKS_FILE ?= "sdimage-bootpart-4g.wks"

# dosfstools is needed to create the boot partition, mtools to copy to it
IMAGE_DEPENDS_wic_append = " dosfstools-native mtools-native parted-native"
IMAGE_BOOT_FILES += " boot.bin atf.ub uEnv.txt system.dtb"

# u-boot is needed for the IMAGE_BOOT_FILES
do_image_wic[depends] += "virtual/bootloader:do_deploy"

MACHINE_EXTRA_RDEPENDS += "mtd-utils"
MACHINE_EXTRA_RRECOMMENDS += "udev-extraconf kernel-modules firmware-wireless"

# Set 128KB eraseblock size for on-board NOR FLASH
JFFS2_ERASEBLOCK ?="0x20000"

# kernel modules for ZynqMP
MACHINE_ESSENTIAL_EXTRA_RRECOMMENDS_append_zynqmp = " kernel-module-mali"

# Metadata used by CodeBench for the ADE
INHERIT += "${@'cb-mbs-options' if 'mentor-private' in '${BBFILE_COLLECTIONS}'.split() else ''}"
ADE_CB_MBS[general.cpu] = "general.cpu.armv8a"
```

## conf/machine/zedboard-zynq7-mel.conf
```bitbake
#@TYPE: Machine
#@NAME: zedboard-zynq7-mel
#@DESCRIPTION: Mentor Embedded Linux Machine support for ZedBoard.
#
# For full details on the ZedBoard and associated tools, refer to the meta-xilinx
# layer.

require conf/machine/include/tune-zynq.inc
require conf/machine/include/machine-xilinx-default.inc
require conf/machine/include/machine-xilinx-board.inc

# Zedboard machine definition known by Xilinx UBOOT
UBOOT_MACHINE = "zynq_zed_config"

SERIAL_CONSOLE = "115200 ttyPS0"

MACHINE_DEVICETREE := " \
		zedboard-mel/zedboard-zynq7-mel.dts \
		"

IMAGE_BOOT_FILES += "boot.bin uEnv.txt ${MACHINE}.dtb"

MACHINE_FEATURES = "vfat ext2 alsa mel-master"

MACHINE_EXTRA_RRECOMMENDS += "udev-extraconf kernel-modules"

MACHINEOVERRIDES_append = ":zedboard"

PREFERRED_PROVIDER_virtual/kernel="linux-xlnx"
IMAGE_BOOT_FILES += "boot.bin ${MACHINE}.dtb"

# WIC image type support
IMAGE_FSTYPES += "wic.bz2"
WKS_FILE ?= "sdimage-bootpart-4g.wks"

# dosfstools is needed to create the boot partition, mtools to copy to it
IMAGE_DEPENDS_wic_append = " dosfstools-native mtools-native parted-native"
```
